## firmware/esp32/subboard/main/Kconfig.projbuild
```kconfig
menu "HeteroLink Configuration"

    config EXAMPLE_WIFI_SSID
        string "WiFi SSID"
        default ""
        help
            WiFi network name (SSID)

    config EXAMPLE_WIFI_PASSWORD
        string "WiFi Password"
        default ""
        help
            WiFi password (WPA/WPA2)
            
    config EXAMPLE_MQTT_BROKER_URI
        string "MQTT Broker URI"
        default "mqtt://test.mosquitto.org:1883"
        help
            MQTT broker URI. Examples:
            - mqtt://test.mosquitto.org:1883 (public test broker)
            - mqtt://192.168.1.100:1883 (local broker)
            - mqtts://broker.emqx.io:8883 (TLS)

endmenu
```

## firmware/esp32/subboard/sdkconfig.defaults
```kconfig
# HeteroLink ESP32 Subboard - 默认配置

# WiFi 配置
CONFIG_HETERO_WIFI_SSID="YourWiFiSSID"
CONFIG_HETERO_WIFI_PASSWORD="YourWiFiPassword"

# MQTT 配置
CONFIG_HETERO_MQTT_BROKER_URI="mqtt://broker.emqx.io"
CONFIG_HETERO_MQTT_BROKER_PORT=1883
CONFIG_HETERO_MQTT_CLIENT_ID="heterolink_subboard_001"
# CONFIG_HETERO_MQTT_USERNAME=""
# CONFIG_HETERO_MQTT_PASSWORD=""

# 设备配置
CONFIG_HETERO_DEVICE_ID="subboard_001"
CONFIG_HETERO_DATA_UPLOAD_INTERVAL=1000

# 功能启用
CONFIG_HETERO_ENABLE_UART_PROTOCOL=y
CONFIG_HETERO_ENABLE_SPI_DMA=n
CONFIG_HETERO_ENABLE_ADC_GPIO_PROBE=y

# 调试配置
CONFIG_LOG_DEFAULT_LEVEL_INFO=y
# CONFIG_LOG_DEFAULT_LEVEL_DEBUG=y
```

## unit/main/Kconfig.projbuild
```kconfig
menu "HeteroLink Configuration"

    menu "WiFi Configuration"
        config HETERO_WIFI_SSID
            string "WiFi SSID"
            default ""
            help
                WiFi network name (SSID)

        config HETERO_WIFI_PASSWORD
            string "WiFi Password"
            default ""
            help
                WiFi password

        config HETERO_WIFI_AUTO_RECONNECT
            bool "Auto Reconnect"
            default y
            help
                Automatically reconnect to WiFi on disconnect
    endmenu

    menu "MQTT Configuration"
        config HETERO_MQTT_BROKER_URI
            string "MQTT Broker URI"
            default "mqtt://broker.emqx.io"
            help
                MQTT broker URI (e.g., mqtt://broker.emqx.io)

        config HETERO_MQTT_BROKER_PORT
            int "MQTT Broker Port"
            default 1883
            help
                MQTT broker port

        config HETERO_MQTT_CLIENT_ID
            string "MQTT Client ID"
            default "heterolink_subboard_001"
            help
                MQTT client identifier

        config HETERO_MQTT_USERNAME
            string "MQTT Username (optional)"
            default ""
            help
                MQTT username (leave empty for no authentication)

        config HETERO_MQTT_PASSWORD
            string "MQTT Password (optional)"
            default ""
            help
                MQTT password (leave empty for no authentication)
    endmenu

    menu "Device Configuration"
        config HETERO_DEVICE_ID
            string "Device ID"
            default "subboard_001"
            help
                Unique device identifier

        config HETERO_DATA_UPLOAD_INTERVAL
            int "Data Upload Interval (ms)"
            default 1000
            help
                Interval for uploading telemetry data

        config HETERO_ENABLE_UART_PROTOCOL
            bool "Enable UART Protocol"
            default y
            help
                Enable UART binary protocol (near-end channel)

        config HETERO_ENABLE_SPI_DMA
            bool "Enable SPI+DMA"
            default n
            help
                Enable SPI+DMA high-speed data transfer

        config HETERO_ENABLE_ADC_GPIO_PROBE
            bool "Enable ADC/GPIO Probe"
            default y
            help
                Enable ADC/GPIO dual-mode probing
    endmenu

    menu "Debug Configuration"
        config HETERO_LOG_LEVEL
            int "Log Level"
            default 3
            range 0 4
            help
                Log level: 0=None, 1=Error, 2=Warning, 3=Info, 4=Debug
    endmenu

    menu "Alarm Configuration"
        config HETERO_ENABLE_ALARM
            bool "Enable Alarm Threshold Checking"
            default y
            help
                Enable automatic alarm publishing when channel values
                exceed configured thresholds.

        config HETERO_ALARM_UPPER_LIMIT
            int "Upper Threshold (raw ADC)"
            default 4000
            range 0 65535
            depends on HETERO_ENABLE_ALARM
            help
                Upper limit for alarm triggering.
                When a channel value exceeds this, an alarm is published.

        config HETERO_ALARM_LOWER_LIMIT
            int "Lower Threshold (raw ADC)"
            default 0
            range 0 65535
            depends on HETERO_ENABLE_ALARM
            help
                Lower limit for alarm triggering.
                When a channel value falls below this, an alarm is published.
    endmenu

endmenu
```

## unit/sdkconfig.defaults
```kconfig
# HeteroLink ESP32-C6 Subboard 固件默认配置

# WiFi 连接
CONFIG_EXAMPLE_WIFI_SSID="lizixin"
CONFIG_EXAMPLE_WIFI_PASSWORD="***"
# 允许 example_connect 内部多次重试（由 app_main 指数退避接管后续重连）
CONFIG_EXAMPLE_WIFI_CONN_MAX_RETRY=10

# 分区表
CONFIG_PARTITION_TABLE_CUSTOM=y
CONFIG_PARTITION_TABLE_CUSTOM_FILENAME="partitions.csv"
CONFIG_PARTITION_TABLE_FILENAME="partitions.csv"

# Flash 大小 (8MB)
CONFIG_ESPTOOLPY_FLASHSIZE_8MB=y
CONFIG_ESPTOOLPY_FLASHSIZE="8MB"

# MQTT5 协议
CONFIG_MQTT_PROTOCOL_5=y

# 功能：仅 WiFi + MQTT + ADC/GPIO
# CONFIG_HETERO_ENABLE_SPI_DMA is not set
CONFIG_HETERO_ENABLE_ADC_GPIO_PROBE=y

# 调试
CONFIG_LOG_DEFAULT_LEVEL_INFO=y
```
